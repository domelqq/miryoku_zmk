// Copyright 2022 Manna Harbour
// https://github.com/manna-harbour/miryoku

/ {
  behaviors {
    u_mt: u_mt {
      compatible = "zmk,behavior-hold-tap";
      #binding-cells = <2>;
      tapping-term-ms = <280>;
      quick-tap-ms = <175>;                // repeat on tap-into-hold
      require-prior-idle-ms = <150>;
      flavor = "balanced";
      bindings = <&kp>, <&kp>;
    };
    u_lt: u_lt {
      compatible = "zmk,behavior-hold-tap";
      #binding-cells = <2>;
      tapping-term-ms = <280>;
      quick-tap-ms = <175>;                // repeat on tap-into-hold
      require-prior-idle-ms = <150>;
      flavor = "balanced";
      bindings = <&mo>, <&kp>;
    };
  };
};
